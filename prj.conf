## CMakeLists.txt
```
#
# Copyright (c) 2019 Nordic Semiconductor
#
# SPDX-License-Identifier: LicenseRef-Nordic-5-Clause
#

cmake_minimum_required(VERSION 3.13.1)

find_package(Zephyr REQUIRED HINTS $ENV{ZEPHYR_BASE})
project(nrf-coap-client)

# NORDIC SDK APP START
target_sources(app PRIVATE 
src/main.c
src/lte_communication.c
src/fsm.c
)

# NORDIC SDK APP END

target_include_directories(app PRIVATE inc)
```

## Kconfig
```
#
# Copyright (c) 2019 Nordic Semiconductor ASA
#
# SPDX-License-Identifier: LicenseRef-Nordic-5-Clause
#

menu "nRF CoAP client sample"

config COAP_SERVER_HOSTNAME
	string "CoAP server hostname"
	default "coap.thingsboard.cloud"

config COAP_URI_PATH_API
	string "CoAP Path"
	default "api/v1/"

config COAP_TELEMETRY
	string "CoAP Path Telemetry"
	default "/telemetry"

config COAP_ATTRIBUTES
	string "CoAP Path Telemetry"
	default "/attributes"

config COAP_SERVER_PORT
	int "CoAP server port"
	default 5683

endmenu

menu "Zephyr Kernel"
source "Kconfig.zephyr"
endmenu
```

## prj.conf
```kconfig
#
# Copyright (c) 2019 Nordic Semiconductor ASA
#
# SPDX-License-Identifier: LicenseRef-Nordic-5-Clause
#
# General config
CONFIG_HEAP_MEM_POOL_SIZE=4096
CONFIG_NEWLIB_LIBC=y


# Networking
CONFIG_NETWORKING=y
CONFIG_NET_NATIVE=n
CONFIG_NET_SOCKETS_OFFLOAD=y
CONFIG_NET_SOCKETS=y
CONFIG_NET_SOCKETS_POSIX_NAMES=y

# LTE link control
CONFIG_LTE_LINK_CONTROL=y
CONFIG_LTE_AUTO_INIT_AND_CONNECT=n


CONFIG_LTE_PSM_REQ_RPTAU="11100011"
CONFIG_LTE_PSM_REQ_RAT="00000001"

# Modem library
CONFIG_NRF_MODEM_LIB=y
CONFIG_NRF_MODEM_LIB_TRACE_ENABLED=n

# AT Host
CONFIG_UART_INTERRUPT_DRIVEN=y
CONFIG_AT_HOST_LIBRARY=y

CONFIG_SERIAL=y
#CONFIG_UART_3_NRF_UARTE=y
#CONFIG_TRUSTED_EXECUTION_NONSECURE=y


CONFIG_GPIO=y

# CoAP
CONFIG_COAP=y

# Main thread
CONFIG_MAIN_STACK_SIZE=4096
CONFIG_PM_DEVICE=y
CONFIG_PM_DEVICE_RUNTIME=y

# Debug
CONFIG_DEBUG_OPTIMIZATIONS=y
#CONFIG_DEBUG_THREAD_INFO=y
#CONFIG_DEBUG_INFO=y
#CONFIG_EXCEPTION_STACK_TRACE=y

#CONFIG_THREAD_ANALYZER=y
#CONFIG_EXTRA_EXCEPTION_INFO=y

CONFIG_LOG=n
#CONFIG_RESET_ON_FATAL_ERROR=n
#CONFIG_NO_OPTIMIZATIONS=y

CONFIG_DATE_TIME=y
```

## nrf9160dk_nrf9160_ns.overlay
```dts
&uart1 {
    status = "okay";
    current-speed = <115200>;
};

&uart3 {
    status = "okay";
    current-speed = <115200>;
    tx-pin = <12>;
    rx-pin = <13>;
};
```

## src/main.c
```c
/**
 *           ______   _    ___        __          ___ ____   ____ 
 *          |__  / | | |  / \ \      / /         |_ _/ ___| / ___|
 *            / /| |_| | / _ \ \ /\ / /   _____   | |\___ \| |    
 *           / /_|  _  |/ ___ \ V  V /   |_____|  | | ___) | |___ 
 *          /____|_| |_/_/   \_\_/\_/            |___|____/ \____|
 * 
 *                Zurich University of Applied Sciences
 *         Institute of Signal Processing and Wireless Communications
 * 
 * ----------------------------------------------------------------------------
 * 
 * \brief		LTE Communication and state handler for Siedlungsentwässerung
 * 
 * \copyright 	SPDX-License-Identifier: LicenseRef-Nordic-5-Clause
 * \author		Matthias Ludwig (ludw)
 * \version		1.0
 */

#include <stdio.h>
#include <string.h>

#include <zephyr.h>
#include <net/coap.h>
#include <net/socket.h>
#include <modem/lte_lc.h>

#include "lte_communication.h"
#include "fsm.h"

// ------------------------------------------------------- static variables ---

// -------------------------------------------- private function prototypes ---

// ------------------------------------------------------- public functions ---

void main(void)
{
	printk("Siedlungsentwaesserung started\n");

	fsm_init();
	
	if (lte_init() != 0)
	{
		printk("LTE Connection could not be initialiesed");
		return;
	}

	while (1)
	{
		k_sleep(Z_TIMEOUT_MS(20));
		stateMachine();
	}

	lte_close();
}
```

## inc/fsm.h
```c
/**
 *           ______   _    ___        __          ___ ____   ____ 
 *          |__  / | | |  / \ \      / /         |_ _/ ___| / ___|
 *            / /| |_| | / _ \ \ /\ / /   _____   | |\___ \| |    
 *           / /_|  _  |/ ___ \ V  V /   |_____|  | | ___) | |___ 
 *          /____|_| |_/_/   \_\_/\_/            |___|____/ \____|
 * 
 *                Zurich University of Applied Sciences
 *         Institute of Signal Processing and Wireless Communications
 * 
 * ----------------------------------------------------------------------------
 * 
 * \brief	State machine to handle messurement and sending
 * 
 * \author	Matthias Ludwig (acronym)
 * \version	1.0
 */
#ifndef RADAR_FSM_H_
#define RADAR_FSM_H_

#include <stdio.h>


// --------------------------------------------------------- public structs ---

// ------------------------------------------------------- public functions ---

void fsm_init(void);
void stateMachine(void);

#endif /* RADAR_FSM_H_ */
```

## inc/lte_communication.h
```c
/**
 *           ______   _    ___        __          ___ ____   ____ 
 *          |__  / | | |  / \ \      / /         |_ _/ ___| / ___|
 *            / /| |_| | / _ \ \ /\ / /   _____   | |\___ \| |    
 *           / /_|  _  |/ ___ \ V  V /   |_____|  | | ___) | |___ 
 *          /____|_| |_/_/   \_\_/\_/            |___|____/ \____|
 * 
 *                Zurich University of Applied Sciences
 *         Institute of Signal Processing and Wireless Communications
 * 
 * ----------------------------------------------------------------------------
 * 
 * \brief	Handles the LTE communication with the CoAP protocol
 * 
 * \author	Matthias Ludwig (ludw)
 * \version	1.0
 */

#ifndef _LTE_COMMUNICATION_H
#define _LTE_COMMUNICATION_H

#include <stdint.h>

// --------------------------------------------------------- public structs ---


// ------------------------------------------------------- public functions ---

int lte_init();
void lte_close(void);
int send_data(uint8_t *payload, const uint8_t *acces_token_str);

/**
 * \brief	returns receiving signal power in dbm
 * \param[out] buffer chararray for signal power in ascii
 */
void get_signal_power(uint8_t *buffer);

void nrf_modem_recoverable_error_handler(uint32_t err);


#endif /* _LTE_COMMUNICATION_H */
```

## inc/measure.h
```c
#ifndef MEASURE_H_
#define MEASURE_H_

#include <stdio.h>

void new_time(uint64_t time);
void new_datapoint(void);
void new_distance(uint16_t distance);
void new_speed(uint16_t speed);

void get_results(uint8_t *results);
uint32_t get_last_distance(void);
uint32_t get_last_speed(void);

#endif /* MEASURE_H_ */
```

## inc/radar_communication.h
```c
/**
 *           ______   _    ___        __          ___ ____   ____ 
 *          |__  / | | |  / \ \      / /         |_ _/ ___| / ___|
 *            / /| |_| | / _ \ \ /\ / /   _____   | |\___ \| |    
 *           / /_|  _  |/ ___ \ V  V /   |_____|  | | ___) | |___ 
 *          /____|_| |_/_/   \_\_/\_/            |___|____/ \____|
 * 
 *                Zurich University of Applied Sciences
 *         Institute of Signal Processing and Wireless Communications
 * 
 * ----------------------------------------------------------------------------
 * 
 * \brief	Handles the UART communication to the Acconeer Radar Boards
 * 
 * \author	Matthias Ludwig (ludw)
 * \version	1.0
 */

#ifndef UART_COMMUNICATION_H_
#define UART_COMMUNICATION_H_

#include <stdio.h>
#include <stdbool.h>

// --------------------------------------------------------- public structs ---

// ------------------------------------------------------- public functions ---
void gpio_init(void);
void uart_init(void);

void start_distance_measurement(void);
void start_speed_measurement(uint32_t distance);
bool check_data_received(void);
void rec_distance(void);
void rec_speed(void);



#endif /* UART_COMMUNICATION_H_ */
```

## src/fsm.c
```c
/**
 *           ______   _    ___        __          ___ ____   ____ 
 *          |__  / | | |  / \ \      / /         |_ _/ ___| / ___|
 *            / /| |_| | / _ \ \ /\ / /   _____   | |\___ \| |    
 *           / /_|  _  |/ ___ \ V  V /   |_____|  | | ___) | |___ 
 *          /____|_| |_/_/   \_\_/\_/            |___|____/ \____|
 * 
 *                Zurich University of Applied Sciences
 *         Institute of Signal Processing and Wireless Communications
 * 
 * ----------------------------------------------------------------------------
 * 
 * \brief	State machine to handle messurement and sending
 * 
 * \author	Matthias Ludwig (acronym)
 * \version	1.0
 */

#include "lte_communication.h"
#include "fsm.h"

#include <zephyr.h>
#include <string.h>

#define COAP_SEND_INTERVAL_MS_DEFAULT K_SECONDS(10)

// ------------------------------------------------------- static variables ---

const uint8_t acces_token[] = "ANKKtru6meb6lMSxqntw";

//Timer
static struct k_timer send_timer;
static uint32_t i = 0;

static bool send_timer_flag = 0;

// -------------------------------------------- private function prototypes ---

static void timer_init(void);

// ------------------------------------------------------- public functions ---

void fsm_init(void)
{
    timer_init();
}

void stateMachine(void)
{
    uint8_t result_buffer[100];
    uint8_t sig_pwr[21];
    result_buffer[0] = '\0';

    if (send_timer_flag)
    {
        printk("%u\n",i);
        i++;

        get_signal_power(sig_pwr);
        strcat(result_buffer, "{'RSRP': ");
        strcat(result_buffer, sig_pwr);
        strcat(result_buffer, "}");

        send_data(result_buffer, acces_token);
        send_timer_flag = 0;
    }
}

// ------------------------------------------------------ private functions ---

static void send_timer_handler(struct k_timer *dummy)
{
    send_timer_flag = 1;
}

/*sets the timers for measurement and send time*/
static void timer_init(void)
{
    k_timer_init(&send_timer, send_timer_handler, NULL);
    k_timer_start(&send_timer, COAP_SEND_INTERVAL_MS_DEFAULT, COAP_SEND_INTERVAL_MS_DEFAULT);
}
```

## src/lte_communication.c
```c
/**
 *           ______   _    ___        __          ___ ____   ____ 
 *          |__  / | | |  / \ \      / /         |_ _/ ___| / ___|
 *            / /| |_| | / _ \ \ /\ / /   _____   | |\___ \| |    
 *           / /_|  _  |/ ___ \ V  V /   |_____|  | | ___) | |___ 
 *          /____|_| |_/_/   \_\_/\_/            |___|____/ \____|
 * 
 *                Zurich University of Applied Sciences
 *         Institute of Signal Processing and Wireless Communications
 * 
 * ----------------------------------------------------------------------------
 * 
 * \brief	Handles the LTE communication with the CoAP protocol
 * 
 * \author	Matthias Ludwig (ludw)
 * \version	1.0
 */
#include <stdio.h>
#include <net/coap.h>
#include <net/socket.h>
#include <modem/lte_lc.h>
#include <modem/at_cmd.h>
#include <modem/at_notif.h>
#include <random/rand32.h>
#include <date_time.h>
#if defined(CONFIG_LWM2M_CARRIER)
#include <lwm2m_carrier.h>
#endif

#include "lte_communication.h"

#define APP_COAP_MAX_MSG_LEN 1280
#define APP_COAP_VERSION 1

// ------------------------------------------------------- static variables ---

static int sock;
static struct pollfd fds;
static struct sockaddr_storage server;
static uint16_t next_token;

static uint8_t coap_buf[APP_COAP_MAX_MSG_LEN];

static const char get_signal_power_command[] = "AT+CESQ";

// -------------------------------------------- private function prototypes ---

static int server_resolve(void);
static int client_init(void);
static int client_post_send(uint8_t *payload, const uint8_t *acces_token_str);
static void modem_configure(void);
// ------------------------------------------------------- public functions ---

int lte_init()
{
    int err;

    err = at_cmd_init();
	if (err) {
		printk("Failed to initialize AT commands, err %d\n", err);
		return err;
	}

	err = at_notif_init();
	if (err) {
		printk("Failed to initialize AT notifications, err %d\n", err);
		return err;
	}
    modem_configure();

    err = server_resolve();
    if (err != 0)
    {
        printk("Failed to resolve server name\n");
        return err;
    }

    err = client_init();
    if (err != 0)
    {
        printk("Failed to initialize CoAP client\n");
        return err;
    }

    err = lte_lc_psm_req(true);
    if (err != 0)
    {
        printk("Failed to enable power save mode\n");
        return err;
    }

    err = lte_lc_edrx_req(true);
    if (err != 0)
    {
        printk("Failed to enable eDRX mode\n");
        return err;
    }
    date_time_update_async(NULL);
    return 0;
}

void lte_close(void)
{
    (void)close(sock);
}


int send_data(uint8_t *payload, const uint8_t *acces_token_str)
{
    int err;
    err = client_post_send(payload, acces_token_str);

    return err;
}

void get_signal_power(uint8_t *buffer)
{
    enum at_cmd_state state;
    char temp[50];
    uint8_t *ptr;
    const uint8_t delim[] = ",";
    int16_t signalPower = 0;
    printk("Befor AT\n");
    at_cmd_write(get_signal_power_command, temp, sizeof(temp), &state);
    printk("After AT\n");

    if (state == AT_CMD_OK)
    {
        // rsrp is 5th element of the string
        ptr = strtok(temp, delim);
        for (uint8_t u = 0; u < 5; u++)
        {
            ptr = strtok(NULL, delim);
        }
        signalPower = atoi(ptr);
        signalPower -= 140;
    }

    sprintf(buffer, "%d", signalPower);
    printk("Signal-power: %sdBm\n", buffer);
}

#if defined(CONFIG_NRF_MODEM_LIB)

/**
 * @brief Recoverable modem library error.
*/
void nrf_modem_recoverable_error_handler(uint32_t err)
{
    printk("Modem library recoverable error: %u\n", (unsigned int)err);
}

#endif /* defined(CONFIG_NRF_MODEM_LIB) */

// ------------------------------------------------------ private functions ---

/**
 * @brief Resolves the configured hostname.
 */
static int server_resolve(void)
{
    int err;
    struct addrinfo *result;
    struct addrinfo hints = {
        .ai_family = AF_INET,
        .ai_socktype = SOCK_DGRAM};
    char ipv4_addr[NET_IPV4_ADDR_LEN];

    err = getaddrinfo(CONFIG_COAP_SERVER_HOSTNAME, NULL, &hints, &result);
    if (err != 0)
    {
        printk("ERROR: getaddrinfo failed %d\n", err);
        return -EIO;
    }

    if (result == NULL)
    {
        printk("ERROR: Address not found\n");
        return -ENOENT;
    }

    /* IPv4 Address. */
    struct sockaddr_in *server4 = ((struct sockaddr_in *)&server);

    server4->sin_addr.s_addr =
        ((struct sockaddr_in *)result->ai_addr)->sin_addr.s_addr;
    server4->sin_family = AF_INET;
    server4->sin_port = htons(CONFIG_COAP_SERVER_PORT);

    inet_ntop(AF_INET, &server4->sin_addr.s_addr, ipv4_addr,
              sizeof(ipv4_addr));
    printk("IPv4 Address found %s\n", ipv4_addr);

    /* Free the address. */
    freeaddrinfo(result);

    return 0;
}

/**
 * @brief Initialize the CoAP client 
 */
static int client_init(void)
{
    int err;

    sock = socket(AF_INET, SOCK_DGRAM, IPPROTO_UDP);
    if (sock < 0)
    {
        printk("Failed to create CoAP socket: %d.\n", errno);
        return -errno;
    }

    err = connect(sock, (struct sockaddr *)&server,
                  sizeof(struct sockaddr_in));
    if (err < 0)
    {
        printk("Connect failed : %d\n", errno);
        return -errno;
    }

    /* Initialize FDS, for poll. */
    fds.fd = sock;
    fds.events = POLLIN;

    /* Randomize token. */
    next_token = sys_rand32_get();

    return 0;
}

static int client_post_send(uint8_t *payload, const uint8_t *acces_token_str)
{
    int err;
    struct coap_packet request;

    uint8_t uri_path[50] = "";
    strcat(uri_path, CONFIG_COAP_URI_PATH_API);
    strcat(uri_path, acces_token_str);
    strcat(uri_path, CONFIG_COAP_TELEMETRY);

    next_token++;

    err = coap_packet_init(&request, coap_buf, sizeof(coap_buf),
                           APP_COAP_VERSION, COAP_TYPE_NON_CON,
                           sizeof(next_token), (uint8_t *)&next_token,
                           COAP_METHOD_POST, coap_next_id());
    if (err < 0)
    {
        printk("Failed to create CoAP request, %d\n", err);
        return err;
    }

    err = coap_packet_append_option(&request, COAP_OPTION_URI_PATH,
                                    (uint8_t *)uri_path,
                                    strlen(uri_path));

    if (err < 0)
    {
        printk("Failed to encode CoAP option, %d\n", err);
        return err;
    }

    err = coap_packet_append_payload_marker(&request);
    if (err < 0)
    {
        printk("Failed to add payload marker, %d\n", err);
        return err;
    }

    coap_packet_append_payload(&request, payload, strlen(payload));

    err = send(sock, request.data, request.offset, 0);
    if (err < 0)
    {
        printk("Failed to send CoAP request, %d\n", errno);
        return -errno;
    }
    printk("CoAP request sent: token 0x%04x\n", next_token);

    return 0;
}


/**@brief Configures modem to provide LTE link. Blocks until link is
 * successfully established.
 */
static void modem_configure(void)
{
#if defined(CONFIG_LTE_LINK_CONTROL)
    if (IS_ENABLED(CONFIG_LTE_AUTO_INIT_AND_CONNECT))
    {
        /* Do nothing, modem is already turned on
		 * and connected.
		 */
    }
    else
    {
#if defined(CONFIG_LWM2M_CARRIER)
        /* Wait for the LWM2M_CARRIER to configure the modem and
		 * start the connection.
		 */
        printk("Waiting for carrier registration...\n");
        k_sem_take(&carrier_registered, K_FOREVER);
        printk("Registered!\n");
#else  /* defined(CONFIG_LWM2M_CARRIER) */
        int err;

        printk("LTE Link Connecting ...\n");
        err = lte_lc_init_and_connect();
        __ASSERT(err == 0, "LTE link could not be established.");
        printk("LTE Link Connected!\n");
#endif /* defined(CONFIG_LWM2M_CARRIER) */
    }
#endif /* defined(CONFIG_LTE_LINK_CONTROL) */
}
```

## src/measure.c
```c
/**
 *           ______   _    ___        __          ___ ____   ____ 
 *          |__  / | | |  / \ \      / /         |_ _/ ___| / ___|
 *            / /| |_| | / _ \ \ /\ / /   _____   | |\___ \| |    
 *           / /_|  _  |/ ___ \ V  V /   |_____|  | | ___) | |___ 
 *          /____|_| |_/_/   \_\_/\_/            |___|____/ \____|
 * 
 *                Zurich University of Applied Sciences
 *         Institute of Signal Processing and Wireless Communications
 * 
 * ----------------------------------------------------------------------------
 * 
 * \brief	Storing and converting measurements to json
 * 
 * \author	Matthias Ludwig (ludw)
 * \version	1.0
 */

#include "measure.h"
#include "lte_communication.h"

#include <zephyr.h>
#include <string.h>
#include <nrf9160.h>

// ------------------------------------------------------- static variables ---

typedef struct
{
    uint64_t time;
    uint16_t speed;
    uint16_t distance;
} measure_results;

static measure_results result_buffer[50];
static uint16_t measure_data_counter = 0;

// -------------------------------------------- private function prototypes ---
/**
 * \brief	convert measured data to a json-string
 * \param[inout]	buffer	pointer to a buffer for holding the string
 * \param[in]	flag_rsrp	flag to ad the received signal power
 * \return	nothing
 */
static void structToJSON(uint8_t *buffer, bool flag_rsrp);

/**
 * \brief	prints a uint64_t in a char array
 * \param[inout]	buffer	pointer to a buffer with min length of 21
 * \param[in]	number	number to be printed
 * \return	nothing
 */
void sprintf_uint64(uint8_t *buffer, uint64_t number);

// ------------------------------------------------------- public functions ---

uint32_t get_last_distance(void)
{
    return result_buffer[measure_data_counter].distance;
}

uint32_t get_last_speed(void)
{
    return result_buffer[measure_data_counter].speed;
}

void new_time(uint64_t time)
{
    result_buffer[measure_data_counter].time = time;
    //strcpy(result_buffer[measure_data_counter].time, time);
}

void new_datapoint(void)
{
    measure_data_counter++;
}

void new_distance(uint16_t distance)
{
    result_buffer[measure_data_counter].distance = distance;
}

void new_speed(uint16_t speed)
{
    result_buffer[measure_data_counter].speed = speed;
}

void get_results(uint8_t *results)
{
    structToJSON(results, 1);
    measure_data_counter = 0;
}

// ------------------------------------------------------ private functions ---

static void structToJSON(uint8_t *buffer, bool flag_rsrp)
{
    uint8_t temp[21];
    uint8_t sig_pwr[21];
    uint8_t jsonString[1500];

    jsonString[0] = '\0';
    printk("before get sig pwr\n");
    get_signal_power(sig_pwr);
    printk("after get sig pwr\n");
    strcat(jsonString, "[");
    for (uint16_t m = 1; m <= measure_data_counter; m++)
    {
        strcat(jsonString, "{'ts':");
        sprintf_uint64(temp, result_buffer[m].time);
        strcat(jsonString, temp);
        strcat(jsonString, ",'values': {");
        strcat(jsonString, "'distance': ");
        sprintf(temp, "%d", result_buffer[m].distance);
        strcat(jsonString, temp);
        strcat(jsonString, ",'speed':");
        sprintf(temp, "%d", result_buffer[m].speed);
        strcat(jsonString, temp);

        strcat(jsonString, ",RSRP: ");
        strcat(jsonString, sig_pwr);
        
        strcat(jsonString, "}},");
    }
    jsonString[strlen(jsonString) - 1] = '\0';  // removes last ","
    strcat(jsonString, "]");

    //strcat(jsonString, "{datapoints: ");
    //sprintf(temp, "%d", measure_data_counter);
    //strcat(jsonString, temp);
//
    //if (flag_rsrp)
    //{
    //    get_signal_power(temp);
    //    strcat(jsonString, ",RSRP: ");
    //    strcat(jsonString, temp);
    //}
//
    //if (measure_data_counter)
    //{
    //    strcat(jsonString, ",data: [");
//
    //    for (uint16_t m = 1; m <= measure_data_counter; m++)
    //    {
    //        strcat(jsonString, "{'ts':");
    //        sprintf_uint64(temp, result_buffer[m].time);
    //        strcat(jsonString, temp);
//
    //        strcat(jsonString, ",'distance': ");
    //        sprintf(temp, "%d", result_buffer[m].distance);
    //        strcat(jsonString, temp);
//
    //        strcat(jsonString, ",'speed':");
    //        sprintf(temp, "%d", result_buffer[m].speed);
    //        strcat(jsonString, temp);
//
    //        
    //        strcat(jsonString, "},");
    //    }
    //    jsonString[strlen(jsonString) - 1] = '\0';  // removes last ","
    //    strcat(jsonString, "]}");
    //}
    //else
    //{
    //    strcat(jsonString, "}");
    //}
    printk("%s\n", jsonString);

    strcpy(buffer, jsonString);
}


void sprintf_uint64(uint8_t *buffer, uint64_t number)
{
    uint8_t temp_buffer[21];
    uint8_t i = 0;
    uint8_t str_length = 0;

    do
    {
        temp_buffer[i] = number % 10 + 48;  // convert number to char in reverse order
        number /= 10;
        i++;
    }while(number>0);

    str_length = i;

    for(i=0;i<str_length; i++)
    {
        buffer[i] = temp_buffer[(str_length-1)-i];  // correct order
    }

    buffer[str_length] = '\0';
}
```

## src/radar_communication.c
```c
/**
 *           ______   _    ___        __          ___ ____   ____ 
 *          |__  / | | |  / \ \      / /         |_ _/ ___| / ___|
 *            / /| |_| | / _ \ \ /\ / /   _____   | |\___ \| |    
 *           / /_|  _  |/ ___ \ V  V /   |_____|  | | ___) | |___ 
 *          /____|_| |_/_/   \_\_/\_/            |___|____/ \____|
 * 
 *                Zurich University of Applied Sciences
 *         Institute of Signal Processing and Wireless Communications
 * 
 * ----------------------------------------------------------------------------
 * 
 * \brief	Handles the UART communication to the Acconeer Radar Boards
 * 
 * \author	Matthias Ludwig (ludw)
 * \version	1.0
 */

#include "radar_communication.h"
#include "measure.h"
#include "fsm.h"

#include <zephyr.h>
#include <string.h>
#include <stdlib.h>
#include <drivers/gpio.h>
#include <drivers/uart.h>

// ------------------------------------------------------- static variables ---

//UART
static const struct device *uart1;
static const struct device *uart3;
static uint8_t uart_buf[6];
static uint16_t rx_distance;
static uint16_t rx_speed;
static bool data_received = 0;

//GPIO
static const struct device *gpio_dev;

// -------------------------------------------- private function prototypes ---

static void send_to_speed_measurement(uint32_t speed);
static void send_to_distance_measurement(uint32_t distance);
static void send_uart1(uint8_t *str);
static void send_uart3(uint8_t *str);
static void uart_cb(const struct device *dev, void *user_data);
static void uart_rx_handler(uint8_t buffer);

// ------------------------------------------------------- public functions ---

void uart_init(void)
{
    uart1 = device_get_binding("UART_1");
    uart3 = device_get_binding("UART_3");

    struct uart_config uart_settings;
    uart_settings.baudrate = 9600;
    uart_settings.data_bits = UART_CFG_DATA_BITS_8;
    uart_settings.stop_bits = UART_CFG_STOP_BITS_1;
    uart_settings.parity = UART_CFG_PARITY_NONE;
    uart_settings.flow_ctrl = UART_CFG_FLOW_CTRL_NONE;
    uart_configure(uart1, &uart_settings);
    uart_irq_callback_user_data_set(uart1, uart_cb, NULL);
    //nrf_uarte_enable(uart1);  // TODO check if its usefull
    uart_irq_rx_enable(uart1);

    uart_configure(uart3, &uart_settings);
    uart_irq_callback_user_data_set(uart3, uart_cb, NULL);
    //nrf_uarte_enable(uart3);  // TODO check if its usefull
    uart_irq_rx_enable(uart3);
}

void gpio_init(void)
{
    gpio_dev = device_get_binding("GPIO_0");

    gpio_pin_configure(gpio_dev, 31, GPIO_OUTPUT);
    gpio_pin_configure(gpio_dev, 30, GPIO_OUTPUT);
}

void start_distance_measurement(void)
{
    // wake up radar board
    gpio_pin_set(gpio_dev, 31, true);
    k_sleep(Z_TIMEOUT_MS(2));
    gpio_pin_set(gpio_dev, 31, false);

    k_sleep(Z_TIMEOUT_MS(350));  // TODO Optimize // wait until Radar is powered up
    //send_to_distance_measurement(9999); // DEBUG
    data_received = 1; // DEBUG
}

void start_speed_measurement(uint32_t distance)
{
    // wake up radar board
    gpio_pin_set(gpio_dev, 30, true);
    k_sleep(Z_TIMEOUT_MS(2));
    gpio_pin_set(gpio_dev, 30, false);

    k_sleep(Z_TIMEOUT_MS(350));  // TODO Optimize // wait until Radar is powered up
    //send_to_speed_measurement(distance); // DEBUG
    data_received = 1; // DEBUG
}

void rec_distance(void)
{
    if (data_received)
    {
        rx_distance = 200; // DEBUG
        new_distance(rx_distance);
        printk("rec_distance: %d\n", rx_distance);
        rx_distance = 0;
        data_received = false;
        new_event(DISTANCE_REC_EVENT);
    }
}

void rec_speed(void)
{
    if (data_received)
    {
        rx_speed = 10; // DEBUG
        new_speed(rx_speed);
        rx_speed = 0;
        data_received = 0;
        new_event(SPEED_REC_EVENT);
    }
}

// ------------------------------------------------------ private functions ---

/*send string via uart1*/
static void send_uart1(uint8_t *str)
{
    uint32_t len = strlen(str);
    while (len--)
    {
        uart_poll_out(uart1, *str++);
    }

    k_sleep(Z_TIMEOUT_MS(5));
}

/*send string via uart3*/
static void send_uart3(uint8_t *str)
{
    uint32_t len = strlen(str);
    while (len--)
    {
        uart_poll_out(uart3, *str++);
    }

    k_sleep(Z_TIMEOUT_MS(5));
}

static void send_to_distance_measurement(uint32_t distance)
{
    uint8_t tx_buffer[8];

    sprintf(tx_buffer, "D%df", distance);
    send_uart1(tx_buffer);
}

static void send_to_speed_measurement(uint32_t speed)
{
    uint8_t tx_buffer[8];

    sprintf(tx_buffer, "S%df", speed);
    send_uart3(tx_buffer);
}

/*callback function from uart interrupt read uart string*/
static void uart_cb(const struct device *dev, void *user_data)
{
    uart_irq_update(dev);
    if (uart_irq_rx_ready(dev))
    {
        while (uart_fifo_read(dev, uart_buf, sizeof(uart_buf)))
        {
            uart_rx_handler(uart_buf[0]);
        }
    }
}

static void uart_rx_handler(uint8_t buffer)
{
    static uint8_t i = 0;
    static uint8_t rx_buffer[10];
    static bool distance_flag = 0;
    static bool speed_flag = 0;

    switch (buffer)
    {
    case 'S':
        speed_flag = 1;
        i = 0;
        break;
    case 'D':
        distance_flag = 1;
        i = 0;
        break;
    case 'f':
        rx_buffer[i] = '\0';
        if (distance_flag)
        {
            rx_distance = atoi(rx_buffer);
            distance_flag = 0;
        }
        else if (speed_flag)
        {
            rx_speed = atoi(rx_buffer);
            speed_flag = 0;
        }
        data_received = 1;
        break;
    default:
        rx_buffer[i] = buffer;
        i++;
    }
}
```
